## bsp/qemu-vexpress-a9/applications/components/Kconfig
```kconfig
menu "Custom configuration"

config BSP_USING_ATTR
    bool "Enable BSP_USING_ATTR"
    default n

config BSP_USING_MBEDTLS_MANAGE
    bool "Enable BSP_USING_MBEDTLS_MANAGE"
    default y

endmenu
```
